## main/Kconfig.projbuild
```kconfig
menu "TCP-Serial Bridge Configuration"

    menu "Ethernet Configuration"

        comment "RMII REF_CLK is fixed: 50 MHz input from the PHY on GPIO0"

        config BRIDGE_ETH_IP
            string "Static IPv4 address"
            default "192.168.1.200"

        config BRIDGE_ETH_NETMASK
            string "Subnet mask"
            default "255.255.255.0"

        config BRIDGE_ETH_GATEWAY
            string "Gateway"
            default "192.168.1.1"
            help
                IPv4 gateway of the local network. Only traffic leaving
                the subnet uses it.

        config BRIDGE_ETH_PHY_ADDR
            int "Ethernet PHY address"
            range -1 31
            default -1
            help
                Set to -1 to let the driver find the PHY address.

        config BRIDGE_ETH_PHY_RESET_GPIO
            int "Ethernet PHY reset GPIO"
            range 0 33
            default 5
            help
                The PHY provides the RMII clock and stays in reset until
                this pin is driven high, so a reset GPIO is mandatory on
                the ESP32-Ethernet-Kit. GPIO34-39 are input-only.

        config BRIDGE_ETH_MDC_GPIO
            int "Ethernet MDC GPIO"
            range 0 33
            default 23
            help
                GPIO34-39 are input-only and cannot be used.

        config BRIDGE_ETH_MDIO_GPIO
            int "Ethernet MDIO GPIO"
            range 0 33
            default 18
            help
                GPIO34-39 are input-only and cannot be used.

        config BRIDGE_TCP_PORT
            int "TCP server port"
            range 1 65535
            default 4001

    endmenu

    menu "UART Configuration"

        config BRIDGE_UART_BAUD_RATE
            int "UART1 baud rate"
            range 9600 921600
            default 115200
            help
                Baud rate of the bridge UART (UART1, TX GPIO32, RX GPIO33).
                The frame format is fixed at 8N1 with no hardware flow
                control. 115200 is the default. 921600 is the highest
                supported rate.

    endmenu

    menu "Diagnostics"

        config BRIDGE_UART_LOOPBACK_TEST
            bool "Run UART1 loopback test at boot"
            default n
            help
                Sends a test payload through UART1 once at boot and checks
                that it is received back. Requires GPIO32 and GPIO33 to be
                connected together.

    endmenu

endmenu
```
